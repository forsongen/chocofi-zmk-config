## config/west.yml
```yaml
manifest:
  remotes:
    - name: zmkfirmware
      url-base: https://github.com/zmkfirmware
    - name: forsongen
      url-base: https://github.com/forsongen
  projects:
    - name: zmk
      remote: forsongen
      revision: chocofi
      import: app/west.yml
  self:
    path: config
```
